/*This file is what will ultimately control the DC-DC solid state relays, which turn specific peristaltic pumps on/off
*/
const float PRIME_VALUE[28] = {0, 0, 5.28, 8.05, 4.62, 5.84, 5.25, 7.8, 6.5, 5.13, 6.33, 6.5, 5.56, 0, 0, 0, 0, 0, 0, 0, 0, 0, 6.56, 0, 5.51, 8.9, 4.26, 6.13}; //Duration for which each individual pump should be primed before entering operation

unsigned long timers[28] = {0, 0, 0, 0, 0, 0, 0, 0, 0, 0, 0, 0, 0, 0, 0, 0, 0, 0, 0, 0, 0, 0, 0, 0, 0, 0, 0, 0}; //initialize the timers on each of the pumps to be zero
bool pour_active = false;
int prime_all_count = 0;

unsigned long main_timer;

/*Checks to see if a given pump should be stopped if the pump is currently on
Input: None
Output: None 
*/
void checkPumpDuration(){
  if (pour_active) {
    for (int i = 2; i <= 12; i++) {
      if (millis() >= timers[i] && timers[i] != 0) {
        digitalWrite(i, LOW);
        //Serial.println("Pump Shutdown: " + String(i) + " after " + String(millis() - main_timer));
        timers[i] = 0;
      }
    }
    if (millis() >= timers[22] && timers[22] != 0) {
        digitalWrite(22, LOW);
        //Serial.println("Pump Shutdown: " + String(22) + " after " + String(millis() - main_timer));
        timers[22] = 0;
    }
    for (int i = 24; i <=27; i++) {
      if (millis() >= timers[i] && timers[i] != 0) {
        digitalWrite(i, LOW); 
        //Serial.println("Pump Shutdown: " + String(i) + " after " + String(millis() - main_timer));
        timers[i] = 0;
      }
    }
  }
}

bool updatePourStatus(){
  for (int i = 2; i < 28; i++) {
    int status = digitalRead(i);
    if (status == 1) {
      return true;
    }
  }
  if (pour_active == true) {
    delay(3000);
  }
  return false;
}

void pour(int pumpNumber, float timeInSeconds) {
  timers[pumpNumber] = millis() + (1000 * timeInSeconds);
  //Serial.println("Pump Starting: " + (String(pumpNumber)));
  digitalWrite(pumpNumber, HIGH);
}

void makeDrink(String message) {
 //base case
 if (message.indexOf(";") == -1) {
   int comma_index = message.indexOf(",");
   String pumpNumber = message.substring(0, comma_index);
   String timeInSeconds = message.substring(comma_index+1);
   int pump = pumpNumber.toInt(); 
   float duration = timeInSeconds.toFloat();
   pour(pump, duration);
   return;
 }
  int comma_index = message.indexOf(",");
  String pumpNumber = message.substring(0, comma_index);
  int semi_index = message.indexOf(";");
  String timeInSeconds = message.substring(comma_index + 1, semi_index);
  String newMessage = message.substring(semi_index + 1);
  int pump = pumpNumber.toInt(); 
  float duration = timeInSeconds.toFloat();
  pour(pump, duration);
  makeDrink(newMessage);
}

void setup() {
  Serial.begin(115200);
  //Serial.println("Initializing");
  for (int j = 0; j < 28; j++) {
    pinMode(j, OUTPUT);
    digitalWrite(j, LOW); 
  }  
  delay(3000);
}

void loop() {
  pour_active = updatePourStatus();
  checkPumpDuration();
  if (pour_active == false) {
    String message = Serial.readStringUntil('\n');
    if (message.substring(0,6) == "prime:") {
      if (message.substring(6) == "all" && prime_all_count == 0) {
        for (int pump = 0; pump < 28; pump++) {
          if (PRIME_VALUE[pump] != 0) {
            //Serial.println("Priming Pump " + String(pump));
            digitalWrite(pump, HIGH);
            delay((PRIME_VALUE[pump])*1000);
            digitalWrite(pump, LOW);
          }
        }
        prime_all_count++;
      }
      else {
        //Serial.println("Priming Pump " + message.substring(6));
        main_timer = millis();
        digitalWrite((message.substring(6)).toInt(), HIGH);
        delay(PRIME_VALUE[message.substring(6).toInt()]*1000);
        digitalWrite((message.substring(6)).toInt(), LOW);
        //Serial.println("Ending prime on pump " + message.substring(6) + " after " + String(millis() - main_timer) + " seconds");
      }
    }
    else if (message.substring(0, 5) == "pour:") {
      main_timer = millis();
      makeDrink(message.substring(5));
    } 
  }
}
